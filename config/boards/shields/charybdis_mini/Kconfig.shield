## config/boards/shields/charybdis_mini/Kconfig.shield
```kconfig
# Copyright (c) 2020 Pete Johanson
# SPDX-License-Identifier: MIT

config SHIELD_CHARYBDIS_MINI_LEFT
    def_bool $(shields_list_contains,charybdis_mini_left)

config SHIELD_CHARYBDIS_MINI_RIGHT
    def_bool $(shields_list_contains,charybdis_mini_right)
```

## config/west.yml
```yaml
manifest:
  remotes:
    - name: zmkfirmware
      url-base: https://github.com/zmkfirmware
    # Additional modules containing boards/shields/custom code can be listed here as well
    # See https://docs.zephyrproject.org/3.2.0/develop/west/manifest.html#projects
    - name: DoctorWangWang
      url-base: https://github.com/DoctorWangWang
    - name: badjeff
      url-base: https://github.com/badjeff
  projects:
    - name: zmk
      remote: zmkfirmware
      revision: main
      import: app/west.yml
    - name: zmk-pmw3610-driver
      remote: badjeff
      revision: main
    # - name: zmk-input-processor-report-rate-limit
    #   remote: badjeff
    #   revision: main
  self:
    path: config
```
