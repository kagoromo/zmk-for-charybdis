## config/west.yml
```yaml
manifest:
  remotes:
    - name: zmkfirmware
      url-base: https://github.com/zmkfirmware
    # Additional modules containing boards/shields/custom code can be listed here as well
    # See https://docs.zephyrproject.org/3.2.0/develop/west/manifest.html#projects
    - name: DoctorWangWang
      url-base: https://github.com/DoctorWangWang
    - name: badjeff
      url-base: https://github.com/badjeff
    - name: hsgw
      url-base: https://github.com/hsgw
  projects:
    - name: zmk
      remote: zmkfirmware
      revision: v0.3
      import: app/west.yml
    - name: zmk-pmw3610-driver
      remote: DoctorWangWang
      revision: main
    # - name: zmk-input-processor-report-rate-limit
    #   remote: badjeff
    #   revision: main
    # - name: zmk-feature-sensor_rotation
    #   remote: hsgw
    #   revision: main
  self:
    path: config
```
